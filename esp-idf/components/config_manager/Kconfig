## esp-idf/components/config_manager/Kconfig
```kconfig
# Configuration Manager Settings

menu "Configuration Manager"

    config CONFIG_MGR_NVS_NAMESPACE_WIFI
        string "NVS namespace for WiFi configuration"
        default "botieyes_wifi"
        help
            NVS namespace for storing WiFi credentials and settings.
            
    config CONFIG_MGR_NVS_NAMESPACE_APP
        string "NVS namespace for application configuration"
        default "botieyes_app"
        help
            NVS namespace for application-specific settings (brightness, timeouts).
            
    config CONFIG_MGR_NVS_NAMESPACE_SYS
        string "NVS namespace for system configuration"
        default "botieyes_sys"
        help
            NVS namespace for system settings (crash logs, boot count).

endmenu
```

## esp-idf/components/hal_board/Kconfig
```kconfig
# Hardware Abstraction Layer Configuration

menu "Board Configuration"

    choice BOTIEYES_BOARD_SELECT
        prompt "Select board variant"
        default BOTIEYES_BOARD_TTGO_LORA32
        help
            Select the target board variant. This determines pin mappings,
            display interface (I2C/SPI), and LED type.

        config BOTIEYES_BOARD_TTGO_LORA32
            bool "TTGO LoRa32 (ESP32 + I2C SSD1306)"
            
        config BOTIEYES_BOARD_ESP32S3_SPI
            bool "ESP32-S3 with SPI SSD1306"
            
    endchoice

endmenu

menu "Display Configuration"

    choice BOTIEYES_OLED_PROTOCOL
        prompt "OLED communication protocol"
        default BOTIEYES_OLED_PROTOCOL_I2C if BOTIEYES_BOARD_TTGO_LORA32
        default BOTIEYES_OLED_PROTOCOL_SPI if BOTIEYES_BOARD_ESP32S3_SPI
        help
            Select I2C or SPI for OLED communication.

        config BOTIEYES_OLED_PROTOCOL_I2C
            bool "I2C"
            
        config BOTIEYES_OLED_PROTOCOL_SPI
            bool "SPI"
            
    endchoice
    
    # I2C Configuration
    if BOTIEYES_OLED_PROTOCOL_I2C
        config BOTIEYES_OLED_I2C_SDA
            int "I2C SDA GPIO"
            default 4 if BOTIEYES_BOARD_TTGO_LORA32
            default 21
            
        config BOTIEYES_OLED_I2C_SCL
            int "I2C SCL GPIO"
            default 15 if BOTIEYES_BOARD_TTGO_LORA32
            default 22
            
        config BOTIEYES_OLED_I2C_RST
            int "I2C RST GPIO"
            default 16 if BOTIEYES_BOARD_TTGO_LORA32
            default -1
            
        config BOTIEYES_OLED_I2C_FREQ
            int "I2C frequency (Hz)"
            default 400000
            range 100000 1000000
            
        config BOTIEYES_OLED_I2C_ADDRESS
            hex "I2C address"
            default 0x3C
            range 0x3C 0x3D
    endif
    
    # SPI Configuration
    if BOTIEYES_OLED_PROTOCOL_SPI
        config BOTIEYES_OLED_SPI_MOSI
            int "SPI MOSI GPIO"
            default 11 if BOTIEYES_BOARD_ESP32S3_SPI
            default 23
            
        config BOTIEYES_OLED_SPI_SCK
            int "SPI SCK GPIO"
            default 12 if BOTIEYES_BOARD_ESP32S3_SPI
            default 18
            
        config BOTIEYES_OLED_SPI_CS
            int "SPI CS GPIO"
            default 10 if BOTIEYES_BOARD_ESP32S3_SPI
            default 5
            
        config BOTIEYES_OLED_SPI_DC
            int "SPI DC GPIO"
            default 13 if BOTIEYES_BOARD_ESP32S3_SPI
            default 16
            
        config BOTIEYES_OLED_SPI_RST
            int "SPI RST GPIO"
            default 14 if BOTIEYES_BOARD_ESP32S3_SPI
            default 17
            
        config BOTIEYES_OLED_SPI_FREQ
            int "SPI frequency (Hz)"
            default 10000000
            range 1000000 80000000
    endif

endmenu

menu "LED Configuration"

    choice BOTIEYES_LED_TYPE
        prompt "Status LED type"
        default BOTIEYES_LED_TYPE_GPIO if BOTIEYES_BOARD_TTGO_LORA32
        default BOTIEYES_LED_TYPE_WS2812 if BOTIEYES_BOARD_ESP32S3_SPI
        help
            Select LED type: simple GPIO or addressable WS2812.

        config BOTIEYES_LED_TYPE_NONE
            bool "None (no LED)"
            
        config BOTIEYES_LED_TYPE_GPIO
            bool "GPIO LED"
            
        config BOTIEYES_LED_TYPE_WS2812
            bool "WS2812 addressable LED"
            
    endchoice
    
    config BOTIEYES_LED_GPIO_PIN
        int "LED GPIO pin"
        default 2 if BOTIEYES_BOARD_TTGO_LORA32
        default -1
        depends on BOTIEYES_LED_TYPE_GPIO
        
    config BOTIEYES_LED_WS2812_GPIO
        int "WS2812 GPIO pin"
        default 38 if BOTIEYES_BOARD_ESP32S3_SPI
        default 2
        depends on BOTIEYES_LED_TYPE_WS2812

endmenu
```

## esp-idf/components/hal_board/Kconfig.projbuild
```kconfig
# Display Type Selection (Top-level menuconfig)

menu "Display Type Selection"

    choice DISPLAY_TYPE
        prompt "Display driver type"
        default DISPLAY_TYPE_SSD1306_I2C
        help
            Select the display driver to use for BotiEyes rendering.
            This determines which hardware driver is compiled and linked.

        config DISPLAY_TYPE_SSD1306_I2C
            bool "SSD1306 (I2C)"
            help
                Monochrome 128x64 OLED via I2C (TTGO LoRa32 default).

        config DISPLAY_TYPE_SSD1306_SPI
            bool "SSD1306 (SPI)"
            help
                Monochrome 128x64 OLED via SPI.

        config DISPLAY_TYPE_ST7789_SPI
            bool "ST7789 (SPI)"
            help
                Color TFT LCD via SPI (TTGO T-Display 240x135).
                Uses nopnop2002/st7789 managed component.

    endchoice

endmenu
```

## esp-idf/components/health_monitor/Kconfig
```kconfig
# Health Monitor Configuration

menu "Health Monitor Configuration"

    config HEALTH_MONITOR_WATCHDOG_TIMEOUT_S
        int "Task watchdog timeout (seconds)"
        default 30
        range 5 300
        help
            Timeout for task watchdog. Tasks must feed watchdog within this period.
            
    config HEALTH_MONITOR_BOOT_LOOP_THRESHOLD
        int "Boot loop detection threshold"
        default 3
        range 2 10
        help
            Number of boots within 60 seconds to trigger safe mode.
            
    config HEALTH_MONITOR_STACK_WATERMARK_WARNING
        int "Stack watermark warning threshold (bytes)"
        default 512
        range 128 2048
        help
            Log warning when task stack high watermark falls below this value.

endmenu
```

## esp-idf/components/ssd1306_config/Kconfig.projbuild
```kconfig
# SSD1306 Display Configuration
#
# Configuration options for SSD1306 monochrome OLED display support.
# Default values are validated for TTGO LoRa32 (I2C) and generic SSD1306 modules.
#
# GPIO pin assignments match nopnop2002/esp-idf-ssd1306 tested configurations.

menu "SSD1306 Display Configuration"
    depends on DISPLAY_TYPE_SSD1306_I2C || DISPLAY_TYPE_SSD1306_SPI

    comment "I2C Configuration (TTGO LoRa32 defaults)"
    depends on DISPLAY_TYPE_SSD1306_I2C

    config BOTIEYES_OLED_I2C_SDA
        int "SDA GPIO pin"
        depends on DISPLAY_TYPE_SSD1306_I2C
        default 4
        range -1 48
        help
            I2C SDA (Data) GPIO pin for SSD1306 display.
            TTGO LoRa32 validated value: GPIO 4

    config BOTIEYES_OLED_I2C_SCL
        int "SCL GPIO pin"
        depends on DISPLAY_TYPE_SSD1306_I2C
        default 15
        range -1 48
        help
            I2C SCL (Clock) GPIO pin for SSD1306 display.
            TTGO LoRa32 validated value: GPIO 15

    config BOTIEYES_OLED_I2C_RST
        int "RESET GPIO pin"
        depends on DISPLAY_TYPE_SSD1306_I2C
        default 16
        range -1 48
        help
            Display reset GPIO pin.
            TTGO LoRa32 validated value: GPIO 16
            Set to -1 to disable hardware reset.

    config BOTIEYES_OLED_I2C_ADDRESS
        hex "I2C Address"
        depends on DISPLAY_TYPE_SSD1306_I2C
        default 0x3C
        help
            I2C slave address for SSD1306 display.
            Common values: 0x3C (most modules), 0x3D (alternative)
            TTGO LoRa32 uses 0x3C.

    comment "SPI Configuration (Generic SSD1306 SPI defaults)"
    depends on DISPLAY_TYPE_SSD1306_SPI

    config BOTIEYES_OLED_SPI_MOSI
        int "MOSI GPIO pin"
        depends on DISPLAY_TYPE_SSD1306_SPI
        default 11
        range -1 48
        help
            SPI MOSI (Master Out Slave In) GPIO pin.

    config BOTIEYES_OLED_SPI_SCK
        int "SCK GPIO pin"
        depends on DISPLAY_TYPE_SSD1306_SPI
        default 12
        range -1 48
        help
            SPI clock GPIO pin.

    config BOTIEYES_OLED_SPI_CS
        int "CS GPIO pin (Chip Select)"
        depends on DISPLAY_TYPE_SSD1306_SPI
        default 10
        range -1 48
        help
            SPI chip select GPIO pin.
            Set to -1 to pull CS low via hardware.

    config BOTIEYES_OLED_SPI_DC
        int "DC GPIO pin (Data/Command)"
        depends on DISPLAY_TYPE_SSD1306_SPI
        default 13
        range -1 48
        help
            Data/Command control GPIO pin.
            Low=command, High=data.

    config BOTIEYES_OLED_SPI_RST
        int "RESET GPIO pin"
        depends on DISPLAY_TYPE_SSD1306_SPI
        default 14
        range -1 48
        help
            Display reset GPIO pin.
            Set to -1 to disable hardware reset.

    config BOTIEYES_OLED_SPI_FREQ
        int "SPI frequency (Hz)"
        depends on DISPLAY_TYPE_SSD1306_SPI
        default 10000000
        range 1000000 20000000
        help
            SPI bus clock frequency in Hz.
            Default: 10 MHz (conservative, works on all hardware)
            Maximum: 20 MHz (may require short wires)

endmenu
```

## esp-idf/components/state_machine/Kconfig
```kconfig
# Application State Machine Configuration

menu "State Machine Configuration"

    config APP_STATE_MUTEX_TIMEOUT_MS
        int "State mutex timeout (milliseconds)"
        default 100
        range 10 1000
        help
            Timeout for acquiring state machine mutex. Should be kept low
            to prevent blocking.

endmenu
```

## esp-idf/components/wifi_manager/Kconfig
```kconfig
# WiFi Manager Configuration

menu "WiFi Manager Configuration"

    config WIFI_MANAGER_MAX_RETRY
        int "Maximum WiFi connection retry attempts"
        default 5
        range 1 20
        help
            Maximum number of times to retry WiFi connection before giving up.
            
    config WIFI_MANAGER_RETRY_DELAY_MS
        int "Initial retry delay (milliseconds)"
        default 1000
        range 100 10000
        help
            Initial delay between retry attempts. Uses exponential backoff.
            
    config WIFI_MANAGER_AUTO_RECONNECT
        bool "Enable automatic reconnection"
        default y
        help
            Automatically retry connection on disconnect.

endmenu
```

## esp-idf/main/Kconfig.projbuild
```kconfig
menu "BotiEyes Network Control"

config BOTIEYES_WIFI_SSID
    string "Wi-Fi SSID"
    default ""
    help
        SSID used by the ESP32 station mode connection.

config BOTIEYES_WIFI_PASSWORD
    string "Wi-Fi password"
    default ""
    help
        Password for the configured SSID.

config BOTIEYES_UDP_PORT
    int "UDP control port"
    range 1 65535
    default 4210
    help
        UDP port for the BotiEyes network control service.

config BOTIEYES_STATUS_LED_PIN
    int "Status LED GPIO pin"
    range -1 48
    default 38
    help
        Optional GPIO used as a boot/status LED. Set to -1 to disable.

config BOTIEYES_FRAME_INTERVAL_MS
    int "Render frame interval (ms)"
    range 10 1000
    default 40
    help
        Main loop period in milliseconds. 40 ms ~= 25 FPS.

endmenu
```

## esp-idf/sdkconfig.defaults
```kconfig
# ST7789 Display Configuration for TENSTAR TS-ESP32-S3
#
# Board: TENSTAR TS-ESP32-S3 Development Board
# Display: 1.14" ST7789 TFT (135x240 RGB565)
# Chip: ESP32-S3-WROOM-1
#
# IMPORTANT: This board uses ESP32-S3 native GPIO pins, NOT ESP32 pins!
# The pinout differs from TTGO T-Display (ESP32 classic).

# Target chip
CONFIG_IDF_TARGET="esp32s3"

# Disable old board detection options (obsolete from earlier phases)
CONFIG_BOTIEYES_BOARD_TTGO_LORA32=
CONFIG_BOTIEYES_BOARD_ESP32S3_SPI=
CONFIG_BOTIEYES_OLED_PROTOCOL_I2C=
CONFIG_BOTIEYES_OLED_PROTOCOL_SPI=

# Display Type Selection
CONFIG_DISPLAY_TYPE_ST7789_SPI=y

# Enable frame buffer for fast rendering (240×135 RGB565 = 65KB)
# Without this, direct pixel rendering is ~100x slower
CONFIG_FRAME_BUFFER=y

# GPIO Pin Configuration (TENSTAR TS-ESP32-S3 - VERIFIED FROM DOCUMENTATION)
# Based on TFT_eSPI library configuration for this board
CONFIG_MOSI_GPIO=35
CONFIG_SCLK_GPIO=36
CONFIG_CS_GPIO=7
CONFIG_DC_GPIO=39
CONFIG_RESET_GPIO=40
CONFIG_BL_GPIO=45

# Display Dimensions (1.14" ST7789 - Landscape orientation)
CONFIG_WIDTH=240
CONFIG_HEIGHT=135

# GRAM Offsets (ST7789 320×240 GRAM, 240×135 visible window)
# Calibrated values for TENSTAR TS-ESP32-S3 - verified working
CONFIG_OFFSETX=40
CONFIG_OFFSETY=53

# SPI Configuration
CONFIG_SPI2_HOST=y
# CONFIG_SPI3_HOST is not set

# SPI Clock Speed (start conservative, increase if stable)
CONFIG_ST7789_SPI_CLOCK_MHZ=20

# Frame Buffer (optional - uses ~65KB RAM)
# CONFIG_FRAME_BUFFER=y

# Display Inversion (test if colors are inverted)
# CONFIG_INVERSION=n

# ESP32-S3 USB Configuration (critical for boot mode)
CONFIG_ESP_CONSOLE_USB_SERIAL_JTAG=y
# CONFIG_ESP_CONSOLE_UART is not set
```
